## boards/arm64/soliloquy/uboot/cubie_a5e_defconfig
```kconfig
# SPDX-License-Identifier: GPL-2.0+
#
# U-Boot configuration for Radxa Cubie A5E (Allwinner A527)
# This is used to boot Soliloquy OS on the Cubie A5E board.
#

# ============================================================================
# Architecture and SoC
# ============================================================================
CONFIG_ARM=y
CONFIG_ARCH_SUNXI=y
CONFIG_MACH_SUN55I=y
CONFIG_MACH_SUN55I_A527=y
CONFIG_DRAM_CLK=792
CONFIG_DRAM_LPDDR4=y
CONFIG_MMC_SUNXI_SLOT_EXTRA=2

# ============================================================================
# Target Board
# ============================================================================
CONFIG_TARGET_CUBIE_A5E=y
CONFIG_IDENT_STRING=" Soliloquy Cubie-A5E"
CONFIG_DEFAULT_DEVICE_TREE="allwinner-a527-cubie-a5e"

# ============================================================================
# ARM/Cache Configuration
# ============================================================================
CONFIG_ARM64=y
CONFIG_ARM64_SUPPORT_AARCH32=n
CONFIG_SYS_CONFIG_NAME="sun55i_a527"
CONFIG_SYS_TEXT_BASE=0x4A000000
CONFIG_SYS_MALLOC_LEN=0x800000
CONFIG_SYS_LOAD_ADDR=0x42000000

# ============================================================================
# Boot Configuration
# ============================================================================
CONFIG_DISTRO_DEFAULTS=y
CONFIG_BOOTDELAY=3
CONFIG_USE_BOOTARGS=y
CONFIG_BOOTARGS="console=ttyS0,115200 earlycon=sunxi,0x02500000 kernel.serial=legacy"
CONFIG_BOOTCOMMAND="run soliloquy_boot"

# Extra environment variables for Soliloquy boot
CONFIG_EXTRA_ENV_SETTINGS=" \
	kernel_addr_r=0x42000000\0 \
	fdt_addr_r=0x4FA00000\0 \
	ramdisk_addr_r=0x4FE00000\0 \
	zbi_addr=0x42000000\0 \
	zbi_name=zircon.zbi\0 \
	soliloquy_boot=if mmc dev ${mmc_bootdev}; then " \
		"if load mmc ${mmc_bootdev}:1 ${zbi_addr} ${zbi_name}; then " \
			"echo Booting Soliloquy from MMC...; " \
			"booti ${zbi_addr}; " \
		"fi; " \
	"fi\0 \
	mmc_bootdev=0\0"

# ============================================================================
# Console/UART
# ============================================================================
CONFIG_REQUIRE_SERIAL_CONSOLE=y
CONFIG_SERIAL=y
CONFIG_DM_SERIAL=y
CONFIG_CONS_INDEX=0
CONFIG_BAUDRATE=115200

# ============================================================================
# MMC/Storage
# ============================================================================
CONFIG_MMC=y
CONFIG_DM_MMC=y
CONFIG_MMC_SUNXI=y
CONFIG_MMC_SUNXI_HAS_NEW_MODE=y
CONFIG_MMC_SPEED_MODE_SET=y
CONFIG_MMC_HS200_SUPPORT=y

# SD Card (mmc0)
CONFIG_SUPPORT_EMMC_BOOT=y

# eMMC (mmc2)
CONFIG_MMC_SDHCI_ADMA=y

# ============================================================================
# Networking
# ============================================================================
CONFIG_NET=y
CONFIG_DM_ETH=y
CONFIG_ETH_DESIGNWARE=y
CONFIG_RGMII=y
CONFIG_PHY_REALTEK=y

# ============================================================================
# USB
# ============================================================================
CONFIG_USB=y
CONFIG_DM_USB=y
CONFIG_USB_MUSB_SUNXI=y
CONFIG_USB_XHCI_HCD=y
CONFIG_USB_XHCI_DWC3=y
CONFIG_USB_DWC3=y
CONFIG_USB_STORAGE=y
CONFIG_USB_KEYBOARD=y

# ============================================================================
# Display (optional for headless)
# ============================================================================
CONFIG_VIDEO=y
CONFIG_DM_VIDEO=y
CONFIG_VIDEO_SUNXI=n
CONFIG_SPLASH_SCREEN=n

# HDMI
CONFIG_VIDEO_BRIDGE=n

# ============================================================================
# I2C / PMIC
# ============================================================================
CONFIG_DM_I2C=y
CONFIG_I2C_MV=y
CONFIG_SYS_I2C_MVTWSI=y
CONFIG_DM_PMIC=y
CONFIG_PMIC_AXP=y
CONFIG_AXP323_POWER=y

# ============================================================================
# GPIO
# ============================================================================
CONFIG_DM_GPIO=y
CONFIG_SUNXI_GPIO=y

# ============================================================================
# Clock
# ============================================================================
CONFIG_CLK=y
CONFIG_CLK_SUNXI=y

# ============================================================================
# SPL Configuration (Secondary Program Loader)
# ============================================================================
CONFIG_SPL=y
CONFIG_SPL_FRAMEWORK=y
CONFIG_SPL_TEXT_BASE=0x00020000
CONFIG_SPL_MAX_SIZE=0x20000
CONFIG_SPL_STACK=0x00058000
CONFIG_SPL_BSS_START_ADDR=0x00058000
CONFIG_SPL_BSS_MAX_SIZE=0x2000

# SPL features
CONFIG_SPL_BOARD_INIT=y
CONFIG_SPL_SERIAL=y
CONFIG_SPL_I2C=y
CONFIG_SPL_POWER=y
CONFIG_SPL_MMC=y
CONFIG_SPL_WATCHDOG=y

# ============================================================================
# Filesystem Support
# ============================================================================
CONFIG_FS_EXT4=y
CONFIG_FS_FAT=y
CONFIG_FAT_WRITE=y
CONFIG_CMD_FS_GENERIC=y

# ============================================================================
# Commands
# ============================================================================
CONFIG_CMD_BOOTZ=n
CONFIG_CMD_BOOTI=y
CONFIG_CMD_BOOTM=y
CONFIG_CMD_CACHE=y
CONFIG_CMD_DHCP=y
CONFIG_CMD_ECHO=y
CONFIG_CMD_EXT4=y
CONFIG_CMD_FAT=y
CONFIG_CMD_GPIO=y
CONFIG_CMD_I2C=y
CONFIG_CMD_MMC=y
CONFIG_CMD_NET=y
CONFIG_CMD_PING=y
CONFIG_CMD_POWEROFF=y
CONFIG_CMD_USB=y

# ============================================================================
# Security
# ============================================================================
CONFIG_SECURE_BOOT=n
CONFIG_FIT=y
CONFIG_FIT_SIGNATURE=n

# ============================================================================
# Debug
# ============================================================================
CONFIG_LOGLEVEL=7
CONFIG_LOG=y
CONFIG_LOG_MAX_LEVEL=7
CONFIG_LOG_DEFAULT_LEVEL=6
CONFIG_DEBUG_UART=y
CONFIG_DEBUG_UART_BASE=0x02500000
CONFIG_DEBUG_UART_CLOCK=24000000
```
